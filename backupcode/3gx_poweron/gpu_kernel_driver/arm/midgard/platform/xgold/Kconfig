## backupcode/3gx_poweron/gpu_kernel_driver/arm/midgard/platform/xgold/Kconfig
```kconfig
#
# Copyright (C) 2014 Intel Mobile Communications GmbH
#
# This program is free software and is provided to you under the terms of the
# GNU General Public License version 2 as published by the Free Software
# Foundation, and any use by you of this program is subject to the terms
# of such GNU licence.
#
#
config MALI_MIDGARD_XGOLD_THERMAL
	bool "Enable Thermal Throttling"
	depends on  MALI_MIDGARD
	default n
	help
	  Choose this option to enable Thermal throttling in the Mali Midgard DDK
	  platform adaptation.
```

## backupcode/dp550_spec/kernel_doc/devicetree/bindings/video/mali-dp.txt
```
#
# (C) COPYRIGHT 2014-2015 ARM Limited. All rights reserved.
#
# This program is free software and is provided to you under the terms of the
# GNU General Public License version 2 as published by the Free Software
# Foundation, and any use by you of this program is subject to the terms
# of such GNU licence.
#
# A copy of the licence is included with the program, and can also be obtained
# from Free Software Foundation, Inc., 51 Franklin Street, Fifth Floor,
# Boston, MA  02110-1301, USA.
#
#


* ARM Mali-DP Display devices

Required properties:
- compatible: Should be "arm,mali-dpxxx" where "xxx" is the product number
- reg: Physical base address and length of the registers in the system
- interrupts: the interrupt line numbers of the device in the system
- interrupt-names: contains the names of the IRQs in the order they were
provided in the "interrupts" property. Must contain: "SE", "DE".
- clocks: should contain a phandle + clock-specifier pair for each clock
entry in clock-names.
- clock-names: should contain:
      * "mclk": main clock
      * "pclk": APB interface clock
      * "aclk": AXI interface clock
      * "pxclk": pixel clock

Optional properties:
- de-axi-burst-length: this is the burst length in bytes that the DE will use
for reading data from the AXI interface.
  Allowed parameters are: <1>, <2>, <4>, <8>, <16>, <32>, <64>, <128>, <256>
- de-axi-poutstdcab: this is AXI outstanding transcations capability during
  prefetch region. Valid value range 1 - 32. This property is only available
  in DP550.
- de-axi-outstanding-transactions: this is the number of outstanding
transactions which can be generated by the DE. Valid values range 1-32.
- de-axi-arqos-threshold-low: the DE input FIFO level low threshold. Valid value
range 1 - (FIFO size - 1).
- de-axi-arqos-threshold-high: the DE input FIFO level high threshold. Valid
value range 1 - (FIFO size - 1) and should not be less than value indicated by
de-axi-arqos-threshold-low.
- de-axi-arqos-red: Close to underflow ARQOS value. Valid value range 0 - 15.
- de-axi-arqos-green: Normal conditions ARQOS value. Valid value range 0 - 15.
- se-axi-burst-length: this is the burst length in bytes  the SE will use for
writing data to the AXI interface.
  Allowed parameters are: <1>, <2>, <4>, <8>, <16>, <32>, <64>, <128>, <256>
- se-axi-outstanding-transactions: this is the number of outstanding
transactions which can be generated by the SE. Valid values range 1-32.
- se-axi-awqos: identifier used by the AXI4 interface to establish a QoS mechanism.
  Values must be in the range [0-15].
- se-axi-awcache: memory type as defined by the AXI4 specification.
  Values must be in the range [0-15].
- rotmem: the size (in KB) of the available rotation memory

The device node should contain one 'port' child node with one child 'endpoint'
node, according to the bindings defined in Documentation/devicetree/bindings/
media/video-interfaces.txt. The endpoint has the following required
properties:
- remote-endpoint: The phandle of the 'input' endpoint of the attached video
transmitter device.

Note: Each Mali-DP node should have an alias "malidpX" where X is a correct
number in the "aliases" node.

Example:

aliases {
	malidp0 = &dp0;
};

dp0: display {
	compatible = "arm,mali-dp500";
	reg = <0xf0040000 0x1000>;
	interrupts = <0 39 4>, <0 40 4>;
	interrupt-names = "SE", "DE";
	clocks = <&db2oscclk2>, <&db2oscclk2>, <&db2oscclk0>, <&db2oscclk0>;
	clock-names = "pxclk", "mclk", "aclk", "pclk";
	de-axi-burst-length = <32>;
	de-axi-outstanding-transactions = <15>;
	de-axi-arqos-threshold-low = <112>;
	de-axi-arqos-threshold-high = <128>;
	de-axi-arqos-red = <1>;
	de-axi-arqos-green = <0>;
	se-axi-burst-length = <32>;
	se-axi-outstanding-transactions = <15>;
	se-axi-awqos = <15>;
	se-axi-awcache = <0>;
	rotmem = <64>;
	port {
		dp0_out: endpoint {
			remote-endpoint = <&tx0_in>;
		};
	};
};

tx0: video-transmitter {
	compatible = "foo,bar-tx";
	port {
		tx0_in: endpoint {
			remote-endpoint = <&dp0_out>;
		};
	};
};
```

## backupcode/dp550_spec/kernel_doc/devicetree/bindings/video/senc_tx.txt
```
#
# (C) COPYRIGHT 2015 ARM Limited. All rights reserved.
#
# This program is free software and is provided to you under the terms of the
# GNU General Public License version 2 as published by the Free Software
# Foundation, and any use by you of this program is subject to the terms
# of such GNU licence.
#
# A copy of the licence is included with the program, and can also be obtained
# from Free Software Foundation, Inc., 51 Franklin Street, Fifth Floor,
# Boston, MA  02110-1301, USA.
#
#


* DRM slave encoder video-tx wrapper

This node is for a virtual device which provides a shim to interface a DRM
slave encoder with the video-tx framework.

Required properties:
- compatible: Should be "generic,slave_enc_video_tx"
- i2c-slave: The phandle of the slave encoder's node

Optional properties:
- type: The connector type the transmitter uses
  Allowed values: "HDMI", "DVI"
- type-idx: The number of the connector of the given type, for instance
  HDMI-0 and HDMI-1 would have type-idx = <0> and <1> respectively.

The device node should contain one 'port' child node with one child 'endpoint'
node according to the bindings defined in Documentation/devicetree/bindings/
media/video-interfaces.txt. The endpoint has the following required
properties:
- remote-endpoint: The phandle of the 'output' endpoint of the attached video
source device.

Example:

tx0: video_tx@0 {
	compatible = "generic,slave_enc_video_tx";
	reg = <0>;
	i2c-slave = <&dvi2>;
	type = "HDMI";
	type-idx = <0>;
	port {
		tx0_in: endpoint {
			remote-endpoint = <&dp0_out>;
		};
	};
};
```

## backupcode/dp550_spec/kernel_doc/devicetree/bindings/video/test_video_tx.txt
```
#
# (C) COPYRIGHT 2014 ARM Limited. All rights reserved.
#
# This program is free software and is provided to you under the terms of the
# GNU General Public License version 2 as published by the Free Software
# Foundation, and any use by you of this program is subject to the terms
# of such GNU licence.
#
# A copy of the licence is included with the program, and can also be obtained
# from Free Software Foundation, Inc., 51 Franklin Street, Fifth Floor,
# Boston, MA  02110-1301, USA.
#
#


* Dummy Video Transmitter driver

Required properties:
- compatible: Should be "generic,video_transmitter"

The device node should contain one 'port' child node with one child 'endpoint'
node, according to the bindings defined in Documentation/devicetree/bindings/
media/video-interfaces.txt. The endpoint has the following required
properties:
- remote-endpoint: The phandle of the 'output' endpoint of the attached video
source device.

Example:

tx0: video-transmitter {
	compatible = "generic,video_transmitter";
	port {
		tx0_in: endpoint {
			remote-endpoint = < ... >;
		};
	};
};
```

## backupcode/dp550kernel/arm/Kconfig
```kconfig
#
# (C) COPYRIGHT ARM Limited. All rights reserved.
#
# This program is free software and is provided to you under the terms of the
# GNU General Public License version 2 as published by the Free Software
# Foundation, and any use by you of this program is subject to the terms
# of such GNU licence.
#
# A copy of the licence is included with the program, and can also be obtained
# from Free Software Foundation, Inc., 51 Franklin Street, Fifth Floor,
# Boston, MA  02110-1301, USA.
#
#

config MALI_DP
	depends on ADF
	select VIDEO_TX
	tristate "Mali-DPxxx ADF driver"
	---help---
	  This Atomic Display Framework driver is for the Mali-DP series
	  of display processors.

config MALI_DP_DEBUG
	depends on MALI_DP
	bool "Mali-DP driver debug output enable"
	---help---
	  This enables debug output for the Mali-DP driver
```

## backupcode/dp550kernel/video-tx/Kconfig
```kconfig
#
# (C) COPYRIGHT ARM Limited. All rights reserved.
#
# This program is free software and is provided to you under the terms of the
# GNU General Public License version 2 as published by the Free Software
# Foundation, and any use by you of this program is subject to the terms
# of such GNU licence.
#
# A copy of the licence is included with the program, and can also be obtained
# from Free Software Foundation, Inc., 51 Franklin Street, Fifth Floor,
# Boston, MA  02110-1301, USA.
#
#

config VIDEO_TX
	tristate "Video Transmitter Framework"
	---help---
	This framework provides an abstraction for the video transmitter
	hardware.

if VIDEO_TX
config TEST_VIDEO_TX
	depends on VIDEO_TX
	tristate "Test driver for the Video Transmitter Framework"
	---help---
	This video transmitter device driver provides a test implementation of
	the video transmitter framework useful for initial platform bringup
	as well as testing the transmitter framework functionality.

config SENC_TX
	depends on VIDEO_TX
	tristate "DRM Slave encoder wrapper for Video Transmitter Framework"
	---help---
	This module can wrap around a DRM slave encoder implementation to provide
	a video-tx driver.

endif
```

## patches/patches_shbuild555/old/kconfig.patch
```kconfig
diff --git a/input/touchscreen/Kconfig b/input/touchscreen/Kconfig
index d452e49..daaea43 100644
--- a/input/touchscreen/Kconfig
+++ b/input/touchscreen/Kconfig
@@ -28,3 +28,4 @@ config TOUCHSCREEN_ATMEL_MXT_FORK
 	  module will be called atmel_mxt_ts.
 
 source "drivers/external_drivers/drivers/input/touchscreen/rmi4/Kconfig"
+source "drivers/external_drivers/drivers/input/touchscreen/gt9xx/Kconfig"
diff --git a/input/touchscreen/gt9xx/Kconfig b/input/touchscreen/gt9xx/Kconfig
new file mode 100644
index 0000000..be90b45
--- /dev/null
+++ b/input/touchscreen/gt9xx/Kconfig
@@ -0,0 +1,12 @@
+config TOUCHSCREEN_GOODIX_GT9XX
+	tristate "Goodix I2C Touchscreen"
+	depends on I2C && INPUT
+	help
+	  Say Y here if you have Goodix GT9xx series I2C touch screen,
+	  such as gt911, connected to your system.
+
+	  If unsure, say N.
+
+	  To compile this driver as a module, choose M here: the
+	  module will be called gt9xx_ts.
+
```
